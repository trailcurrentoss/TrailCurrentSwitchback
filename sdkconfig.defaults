## sdkconfig.defaults
```kconfig
# Target
CONFIG_IDF_TARGET="esp32s3"

# Flash
CONFIG_ESPTOOLPY_FLASHSIZE_16MB=y

# PSRAM (8MB OPI)
CONFIG_SPIRAM=y
CONFIG_SPIRAM_MODE_OCT=y
CONFIG_SPIRAM_SPEED_80M=y
CONFIG_SPIRAM_BOOT_INIT=y
CONFIG_PARTITION_TABLE_CUSTOM=y
CONFIG_PARTITION_TABLE_CUSTOM_FILENAME="partitions.csv"

# TWAI (CAN)
CONFIG_TWAI_ISR_IN_IRAM=y

# FreeRTOS
CONFIG_FREERTOS_HZ=1000

# Log level
CONFIG_LOG_DEFAULT_LEVEL_INFO=y
CONFIG_LOG_MAXIMUM_LEVEL_DEBUG=y

# NVS
CONFIG_NVS_ENCRYPTION=n

# WiFi
CONFIG_ESP_WIFI_ENABLED=y

# USB CDC console
CONFIG_ESP_CONSOLE_USB_SERIAL_JTAG=y
```
